## drivers/video/rockchip/mpp/Kconfig
```kconfig
# SPDX-License-Identifier: GPL-2.0
config ROCKCHIP_MPP_SERVICE
	tristate "Rockchip MPP service framework"
	depends on ARCH_ROCKCHIP && ROCKCHIP_IOMMU
	default m
	select DMA_SHARED_BUFFER
	help
	  Rockchip Media Process Platform service framework. Provides the
	  /dev/mpp_service character device and the shared task, IOMMU, clock,
	  and power-management core used by the selected RK3588 clients.

if ROCKCHIP_MPP_SERVICE

config ROCKCHIP_MPP_PROC_FS
	bool
	depends on PROC_FS
	default y
	help
	  Expose per-device runtime state under /proc/mpp_service.

config ROCKCHIP_MPP_RKVENC2
	bool "RKVENC2 (VEPU580) H.264/H.265 encoder"
	default y
	help
	  Hardware video encoder VEPU580 found on RK3588.

config ROCKCHIP_MPP_RKVDEC2
	bool "RKVDEC2 (VDPU381) H.264/H.265/VP9 decoder"
	default y
	help
	  Hardware video decoder VDPU381 found on RK3588.

config ROCKCHIP_MPP_JPGDEC
	bool "RKJPEGD JPEG decoder"
	default y
	help
	  Hardware JPEG decoder exposed through the Rockchip MPP ABI.

config ROCKCHIP_MPP_CERALIVE_TEST
	bool "CeraLive MPP fault-injection test seams"
	default n
	help
	  Enable the fault and timeout seams used by the island KUnit suite.

# MNH-23: These clients remain in the source tree for provenance and future
# ownership work, but this island release neither compiles nor advertises them.
# BROKEN is deliberate fail-closed policy, not a statement about source quality.
config ROCKCHIP_MPP_RKVDEC
	bool "RKV decoder v1 device driver"
	depends on BROKEN
	help
	  Source-complete legacy RKV decoder; not selectable in this island release.

config ROCKCHIP_MPP_RKVENC
	bool "RKV encoder v1 device driver"
	depends on BROKEN
	help
	  Source-complete legacy RKV encoder; not selectable in this island release.

config ROCKCHIP_MPP_VDPU1
	bool "VPU decoder v1 device driver"
	depends on BROKEN
	help
	  Source-complete VDPU1 client; not selectable in this island release.

config ROCKCHIP_MPP_VEPU1
	bool "VPU encoder v1 device driver"
	depends on BROKEN
	help
	  Source-complete VEPU1 client; not selectable in this island release.

config ROCKCHIP_MPP_VDPU2
	bool "VPU decoder v2 device driver"
	depends on BROKEN
	help
	  Source-complete VDPU2 client; not selectable in this island release.

config ROCKCHIP_MPP_VEPU2
	bool "VPU encoder v2 device driver"
	depends on BROKEN
	help
	  Source-complete VEPU2 client; not selectable in this island release.

config ROCKCHIP_MPP_VEPU22
	bool "VPU encoder v2.2 device driver"
	depends on BROKEN
	help
	  Source-complete capability slot; not selectable in this island release.

config ROCKCHIP_MPP_IEP2
	bool "IEP2 image enhancement and deinterlacing"
	depends on BROKEN
	help
	  Source-complete IEP2 client; ownership is deferred.

config ROCKCHIP_MPP_JPGENC
	bool "RKJPEGE JPEG encoder"
	depends on BROKEN
	help
	  Source-complete JPEG encoder; the block remains owned by mainline Hantro.

config ROCKCHIP_MPP_AV1DEC
	bool "AV1 decoder"
	depends on BROKEN
	help
	  Source-complete AV1 client; the Verisilicon provider is intentionally absent.

config ROCKCHIP_MPP_VDPP
	bool "VDPP device driver"
	depends on BROKEN
	help
	  Source-complete VDPP client; ownership is deferred.

config ROCKCHIP_MPP_RKVENC2_DEVFREQ
	bool "RKVENC2 devfreq/OPP/thermal"
	depends on BROKEN
	help
	  Preserved source for a future evidence-gated DVFS promotion.

config ROCKCHIP_MPP_RKVDEC2_DEVFREQ
	bool "RKVDEC2 devfreq/OPP/thermal"
	depends on BROKEN
	help
	  Preserved source for a future evidence-gated DVFS promotion.

endif
```

## tests/kunit/Kconfig
```kconfig
# SPDX-License-Identifier: GPL-2.0
config ROCKCHIP_MPP_BOUNDARY_KUNIT_TEST
	tristate "Rockchip MPP request-boundary tests"
	depends on KUNIT
	default KUNIT_ALL_TESTS
	help
	  Exercise the pure request-shape, element-count, class-coverage, and
	  result-copy bounds shared by the RK3588 MPP clients.

config ROCKCHIP_MPP_FAULT_KUNIT_TEST
	tristate "Rockchip MPP fault-injection tests"
	depends on KUNIT
	select WANT_DEV_COREDUMP
	default KUNIT_ALL_TESTS
	help
	  Exercise the atomic one-shot semantics used by the opt-in RKVENC2
	  fault-injection controls.

config ROCKCHIP_MPP_RECOVERY_KUNIT_TEST
	tristate "Rockchip MPP recovery-state tests"
	depends on KUNIT
	default KUNIT_ALL_TESTS
	help
	  Exercise session teardown ordering and pending, running, timeout,
	  finish, and done task transitions without RK3588 hardware.

config ROCKCHIP_MPP_CAPABILITIES_KUNIT_TEST
	tristate "Rockchip MPP capability-reporting tests"
	depends on KUNIT
	default KUNIT_ALL_TESTS
	help
	  Prove userspace sees only clients that are both compiled and probed.

config ROCKCHIP_MPP_TELEMETRY_KUNIT_TEST
	tristate "Rockchip MPP telemetry format tests"
	depends on KUNIT
	default KUNIT_ALL_TESTS
	help
	  Freeze the operator-visible MPP load row produced by the driver.

config ROCKCHIP_RGA_FENCE_KUNIT_TEST
	tristate "Rockchip RGA release-fence tests"
	depends on KUNIT
	select DMA_SHARED_BUFFER
	default KUNIT_ALL_TESTS
	help
	  Exercise the production release-fence terminal helper for every RGA
	  request exit class that must wake an asynchronous consumer.

config ROCKCHIP_RGA_REQUEST_KUNIT_TEST
	tristate "Rockchip RGA request-validation tests"
	depends on KUNIT
	default KUNIT_ALL_TESTS
	help
	  Exercise fail-closed per-plane descriptor, offset, stride, and
	  format validation without binding the RGA driver.

config ROCKCHIP_MEDIA_DMA_POLICY_KUNIT_TEST
	tristate "Rockchip media DMA policy tests"
	depends on KUNIT
	default KUNIT_ALL_TESTS
	help
	  Exercise per-block address widths and DMA mapping-size limits.

config ROCKCHIP_MEDIA_IOCTL_KUNIT_TEST
	bool "Rockchip media direct ioctl boundary tests"
	depends on KUNIT && 64BIT
	depends on !COMPAT
	depends on !ROCKCHIP_MPP_SERVICE && !ROCKCHIP_MULTI_RGA
	select DMA_SHARED_BUFFER
	help
	  Compile the maintained ioctl and session functions with bounded user-copy
	  fixtures. No hardware driver is registered. Run stage_ioctl.py first.

config ROCKCHIP_MEDIA_RUNTIME_PM_KUNIT_TEST
	bool "Rockchip media runtime-PM ownership tests"
	depends on KUNIT && PM
	depends on !ROCKCHIP_MPP_SERVICE && !ROCKCHIP_MULTI_RGA
	help
	  Exercise maintained RGA power/cancellation and JPEG probe functions
	  with real runtime-PM devices and fake hardware. Run stage_ioctl.py first.
```
